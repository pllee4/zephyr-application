## boards/native_posix.conf
```kconfig
CONFIG_CAN=y
CONFIG_CAN_MAX_FILTER=5
CONFIG_CAN_NATIVE_POSIX_INTERFACE_1_NAME="vcan0"
CONFIG_CAN_NATIVE_POSIX_INTERFACE_2_NAME="vcan1"

CONFIG_BOOTLOADER_MCUBOOT=n
CONFIG_MCUMGR_SMP_UART=n

CONFIG_SOC_POSIX=y
CONFIG_BOARD_NATIVE_POSIX_32BIT=y

# # CONFIG_UART_NATIVE_POSIX=y
# # CONFIG_NATIVE_UART_0_ON_OWN_PTY=y
# # CONFIG_NATIVE_UART_0_ON_STDINOUT=n
# # CONFIG_UART_NATIVE_POSIX_PORT_1_ENABLE=n
CONFIG_LOG_BACKEND_NATIVE_POSIX=y

CONFIG_NETWORKING=y
CONFIG_CAN_NATIVE_POSIX=y
CONFIG_ETH_NATIVE_POSIX=n
CONFIG_CAN_NATIVE_POSIX_INTERFACE_1_ENABLED=y
CONFIG_CAN_NATIVE_POSIX_INTERFACE_2_ENABLED=y

CONFIG_NET_SOCKETS=y
CONFIG_NET_SOCKETS_CAN=y
CONFIG_NET_SOCKETS_POSIX_NAMES=y
CONFIG_ETH_NATIVE_POSIX=y
# CONFIG_CAN_NET=y
# CONFIG_NET_L2_CANBUS=y
CONFIG_NET_L2_CANBUS_RAW=y

CONFIG_NET_SOCKETS_CAN_RECEIVERS=4

CONFIG_NETWORKING=y
CONFIG_NET_L2_ETHERNET=y
CONFIG_NET_UDP=y
CONFIG_NET_TCP=y
CONFIG_SLIP_TAP=y
CONFIG_NET_IPV4=y
CONFIG_NET_IPV6=n
CONFIG_NET_SOCKETS=y
CONFIG_NET_SOCKETS_POSIX_NAMES=y

# Network driver config
CONFIG_TEST_RANDOM_GENERATOR=y

# Network address config
CONFIG_NET_CONFIG_SETTINGS=y
CONFIG_NET_CONFIG_NEED_IPV4=y
CONFIG_NET_CONFIG_MY_IPV4_ADDR="10.10.0.10"
CONFIG_NET_CONFIG_PEER_IPV4_ADDR="10.10.0.20"

CONFIG_LOG=y
# CONFIG_NET_LOG=y
# CONFIG_NET_SOCKETS_LOG_LEVEL_DBG=y
## to be able to call net_config_init manually for example of socket_echo
# CONFIG_NET_CONFIG_AUTO_INIT=n 
CONFIG_NET_CONNECTION_MANAGER=y
```

## src/modules/VersionEnquiryManager/testcase.yaml
```yaml
tests:
  # section.subsection
  modules.VersionEnquiryManager:
    # build_only: true
    platform_allow: native_posix
    tags: version_enquiry_manager
    extra_args: BUILD_TESTS=ON
```
